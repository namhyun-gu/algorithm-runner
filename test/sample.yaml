## test/sample.yaml
```yaml
script:
  build: powershell -command "Start-Sleep 1"
  run: python test.py
  clean: powershell -command "Start-Sleep 1"
context:
  timeout: 10
  workdir: test/
tests:
  - input: |
      1 2 3
    output: |
      6
  - input: |
      1 2 4
    output: |
      6
  - input: |
      1 a 1
    output: |
      2
  - input: |
      100
    output: |
      err
```
